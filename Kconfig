## Kconfig
```kconfig
menu "ESPMQTT Configurations"


config MQTT_TRANSPORT_SSL
    bool "Enable MQTT over SSL"
    default y
    help
        Enable MQTT transport over SSL with mbedtls

config MQTT_TRANSPORT_WEBSOCKET
    bool "Enable MQTT over Websocket"
    default y
    help
        Enable MQTT transport over Websocket.

config MQTT_TRANSPORT_WEBSOCKET_SECURE
    bool "Enable MQTT over Websocket Secure"
    default y
    depends on MQTT_TRANSPORT_WEBSOCKET
    depends on MQTT_TRANSPORT_SSL
    help
        Enable MQTT transport over Websocket Secure.

config MQTT_USE_CUSTOM_CONFIG
    bool "MQTT Using custom configurations"
    default n
    help
        Custom MQTT configurations.

config MQTT_TCP_DEFAULT_PORT
    int "Default MQTT over TCP port"
    default 1883
    depends on MQTT_USE_CUSTOM_CONFIG
    help
        Default MQTT over TCP port

config MQTT_WS_DEFAULT_PORT
    int "Default MQTT over Websocket port"
    default 80
    depends on MQTT_USE_CUSTOM_CONFIG
    depends on MQTT_TRANSPORT_WEBSOCKET
    help
        Default MQTT over Websocket port

config MQTT_WSS_DEFAULT_PORT
    int "Default MQTT over Websocket Secure port"
    default 80
    depends on MQTT_USE_CUSTOM_CONFIG
    depends on MQTT_TRANSPORT_WEBSOCKET
    depends on MQTT_TRANSPORT_WEBSOCKET_SECURE
    help
        Default MQTT over Websocket Secure port


endmenu
```

## examples/mqtt_tcp/main/Kconfig.projbuild
```kconfig
menu "MQTT Application sample"

config WIFI_SSID
    string "WiFi SSID"
    default "myssid"
    help
        SSID (network name) for the example to connect to.

config WIFI_PASSWORD
    string "WiFi Password"
    default "mypassword"
    help
        WiFi password (WPA or WPA2) for the example to use.

config BROKER_URL
    string "Broker URL"
    default "mqtt://iot.eclipse.org"
    help
        URL of the broker to connect to

endmenu
```

## test/apps/mqtt/main/Kconfig.projbuild
```kconfig
menu "ESP-MQTT Unit Test Config"

    config MQTT_TEST_BROKER_URI
        string "URI of the test broker"
        default "mqtt://test.mosquitto.org"
        help
            URL of an mqtt broker which this test connects to.

    config MQTT5_TEST_BROKER_URI
        string "URI of the test broker"
        default "mqtt://test.mosquitto.org"
        help
            URL of an mqtt broker which this test connects to.
endmenu
```

## test/host_test/sdkconfig.defaults
```kconfig
CONFIG_IDF_TARGET="linux"
CONFIG_COMPILER_CXX_EXCEPTIONS=y
CONFIG_COMPILER_CXX_RTTI=y
CONFIG_COMPILER_CXX_EXCEPTIONS_EMG_POOL_SIZE=0
CONFIG_UNITY_ENABLE_IDF_TEST_RUNNER=n
CONFIG_GCOV_ENABLED=y
```

## test/mqtt_msg_host_test/sdkconfig.defaults
```kconfig
CONFIG_IDF_TARGET="linux"
CONFIG_COMPILER_CXX_EXCEPTIONS=y
CONFIG_COMPILER_CXX_RTTI=y
CONFIG_COMPILER_CXX_EXCEPTIONS_EMG_POOL_SIZE=0
CONFIG_COMPILER_DISABLE_DEFAULT_ERRORS=y
CONFIG_LOG_COLORS=n
CONFIG_LOG_DEFAULT_LEVEL_DEBUG=y
CONFIG_ESP_MAIN_TASK_STACK_SIZE=10000
```

## test/mqtt_utils_host_test/sdkconfig.defaults
```kconfig
CONFIG_COMPILER_CXX_EXCEPTIONS=y
CONFIG_ESP_MAIN_TASK_STACK_SIZE=10000
CONFIG_IDF_TARGET="linux"
CONFIG_COMPILER_CXX_RTTI=y
CONFIG_COMPILER_DISABLE_DEFAULT_ERRORS=y
```
